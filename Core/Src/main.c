/******************************************************************************
 * File: main.c
 * Project: Paradigm Braking Actuator Control
 *
 * Description:
 * This program controls a servo-based braking actuator using an STM32G474
 * microcontroller. The servo position is controlled via PWM generated by
 * TIM3 Channel 1 (PA6).
 *
 * Commands are received over UART (USART2) from a serial terminal on a PC.
 *
 * Behaviour:
 *   Startup -> servo moves to 900 us (brake applied) and holds
 *   "UP"    -> servo moves to 2350 us (upright/released) and holds
 *   "DOWN"  -> servo moves back to 900 us (brake applied) and holds
 *
 * Hardware Connections:
 *  Servo Signal -> PA6 (TIM3_CH1 PWM output)
 *  Servo Power  -> External 5V supply
 *  Servo Ground -> Shared with STM32 GND
 *
 * Author: Paradigm Student Design Team
 * Date: 2026
 *
 * TIMER CONFIGURATION REQUIRED (in tim.c / CubeMX):
 *   TIM3 Prescaler = 169   (170 MHz / (169+1) = 1 MHz -> 1 tick = 1 us)
 *   TIM3 Period    = 19999 (1 MHz / 20000 = 50 Hz -> 20 ms PWM period)
 *   TIM3 Channel 1 = PWM Generation CH1
 ******************************************************************************/

#include "main.h"
#include "gpio.h"
#include "tim.h"
#include "usart.h"

#include <stdio.h>
#include <stdlib.h>
#include <string.h>

/* Servo pulse limits - calibrated from physical testing */
#define SERVO_UPRIGHT_US    2350    /* upright position - brake fully released */
#define SERVO_APPLIED_US    900     /* brake applied position                  */

#define SERVO_CLAMP_MIN_US  500
#define SERVO_CLAMP_MAX_US  2500

/* Hold signal settings - re-sends pulse after moving to lock position */
#define SERVO_TRAVEL_DELAY_MS   500
#define SERVO_HOLD_PULSES       3
#define SERVO_HOLD_INTERVAL_MS  100


/*
 * Servo_WriteMicroseconds()
 * Sends a pulse width directly to the servo. Clamps to safe limits.
 */
void Servo_WriteMicroseconds(uint16_t us)
{
    if (us < SERVO_CLAMP_MIN_US) us = SERVO_CLAMP_MIN_US;
    if (us > SERVO_CLAMP_MAX_US) us = SERVO_CLAMP_MAX_US;
    __HAL_TIM_SET_COMPARE(&htim3, TIM_CHANNEL_1, us);
}


/*
 * Servo_MoveAndHold()
 * Moves the servo to the given pulse width then re-sends it several
 * times to firmly lock the arm and prevent continued movement.
 */
void Servo_MoveAndHold(uint16_t us)
{
    Servo_WriteMicroseconds(us);
    HAL_Delay(SERVO_TRAVEL_DELAY_MS);

    for (int i = 0; i < SERVO_HOLD_PULSES; i++)
    {
        Servo_WriteMicroseconds(us);
        HAL_Delay(SERVO_HOLD_INTERVAL_MS);
    }
}


/* Redirect printf to UART */
int _write(int file, char *ptr, int len)
{
    HAL_UART_Transmit(&huart2, (uint8_t*)ptr, len, HAL_MAX_DELAY);
    return len;
}


int main(void)
{
    HAL_Init();
    SystemClock_Config();

    MX_GPIO_Init();
    MX_TIM3_Init();
    MX_USART2_UART_Init();

    HAL_TIM_PWM_Start(&htim3, TIM_CHANNEL_1);

    /* On startup move to 900 us (brake applied) and hold */
    printf("Startup: moving to brake applied position (900 us)...\r\n");
    Servo_MoveAndHold(SERVO_APPLIED_US);
    printf("Ready.\r\n\r\n");

    printf("Commands:\r\n");
    printf("  UP   -> move to upright position (2350 us)\r\n");
    printf("  DOWN -> move to brake applied    (900 us)\r\n\r\n");

    uint8_t rx_char;
    char    buffer[8];
    uint8_t index = 0;

    memset(buffer, 0, sizeof(buffer));

    while (1)
    {
        HAL_UART_Receive(&huart2, &rx_char, 1, HAL_MAX_DELAY);

        if (rx_char == '\r' || rx_char == '\n')
        {
            if (index > 0)
            {
                buffer[index] = '\0';

                /* Convert input to uppercase for case-insensitive comparison */
                for (int i = 0; i < index; i++)
                {
                    if (buffer[i] >= 'a' && buffer[i] <= 'z')
                        buffer[i] -= 32;
                }

                if (strcmp(buffer, "UP") == 0)
                {
                    printf("Moving to upright position (2350 us)...\r\n");
                    Servo_MoveAndHold(SERVO_UPRIGHT_US);
                    printf("Done.\r\n\r\n");
                }
                else if (strcmp(buffer, "DOWN") == 0)
                {
                    printf("Moving to brake applied position (900 us)...\r\n");
                    Servo_MoveAndHold(SERVO_APPLIED_US);
                    printf("Done.\r\n\r\n");
                }
                else
                {
                    printf("Unknown command: \"%s\"\r\n", buffer);
                    printf("Valid commands: UP, DOWN\r\n\r\n");
                }
            }

            index = 0;
            memset(buffer, 0, sizeof(buffer));
        }
        else
        {
            if (index < sizeof(buffer) - 1)
            {
                buffer[index++] = rx_char;
            }
        }
    }
}


void SystemClock_Config(void)
{
    RCC_OscInitTypeDef RCC_OscInitStruct = {0};
    RCC_ClkInitTypeDef RCC_ClkInitStruct = {0};

    HAL_PWREx_ControlVoltageScaling(PWR_REGULATOR_VOLTAGE_SCALE1_BOOST);

    RCC_OscInitStruct.OscillatorType      = RCC_OSCILLATORTYPE_HSI;
    RCC_OscInitStruct.HSIState            = RCC_HSI_ON;
    RCC_OscInitStruct.HSICalibrationValue = RCC_HSICALIBRATION_DEFAULT;

    RCC_OscInitStruct.PLL.PLLState  = RCC_PLL_ON;
    RCC_OscInitStruct.PLL.PLLSource = RCC_PLLSOURCE_HSI;
    RCC_OscInitStruct.PLL.PLLM     = RCC_PLLM_DIV4;
    RCC_OscInitStruct.PLL.PLLN     = 85;
    RCC_OscInitStruct.PLL.PLLP     = RCC_PLLP_DIV2;
    RCC_OscInitStruct.PLL.PLLQ     = RCC_PLLQ_DIV2;
    RCC_OscInitStruct.PLL.PLLR     = RCC_PLLR_DIV2;

    if (HAL_RCC_OscConfig(&RCC_OscInitStruct) != HAL_OK) { Error_Handler(); }

    RCC_ClkInitStruct.ClockType =
        RCC_CLOCKTYPE_HCLK   |
        RCC_CLOCKTYPE_SYSCLK |
        RCC_CLOCKTYPE_PCLK1  |
        RCC_CLOCKTYPE_PCLK2;

    RCC_ClkInitStruct.SYSCLKSource   = RCC_SYSCLKSOURCE_PLLCLK;
    RCC_ClkInitStruct.AHBCLKDivider  = RCC_SYSCLK_DIV1;
    RCC_ClkInitStruct.APB1CLKDivider = RCC_HCLK_DIV1;
    RCC_ClkInitStruct.APB2CLKDivider = RCC_HCLK_DIV1;

    if (HAL_RCC_ClockConfig(&RCC_ClkInitStruct, FLASH_LATENCY_4) != HAL_OK) { Error_Handler(); }
}


void Error_Handler(void)
{
    __disable_irq();
    while (1) {}
}

#ifdef USE_FULL_ASSERT
void assert_failed(uint8_t *file, uint32_t line) {}
#endif
